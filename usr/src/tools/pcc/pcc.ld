/*
 * M4KK1 4P1 - pcc.ld
 * Description: Linker script for the self-hosted PCC compiler.
 *
 * Copyright (c) 2026 Yaku Makki
 * SPDX-License-Identifier: 4P1-Custom
 *
 * PCC loads at 0xB00000.  The flat address space layout:
 *   0x600000  Copland (display server)
 *   0x700000  Copland shared region (COPLAND_SHM_BASE)
 *   0x800000  init / login / m4sh / mdm (shell zone)
 *   0x900000  Sprach (window manager)
 *   0xA00000  executables generated by pcc (PCC_LOAD_BASE)
 *   0xB00000  pcc itself (~4 MiB image incl. BSS work areas)
 */

ENTRY(_start)

SECTIONS {
    . = 0xB00000;

    .text ALIGN(4096) : {
        *(.text)
        *(.text.*)
    }

    .rodata ALIGN(4096) : {
        *(.rodata)
        *(.rodata.*)
    }

    .data ALIGN(4096) : {
        *(.data)
        *(.data.*)
    }

    .bss ALIGN(4096) : {
        __bss_start = .;
        *(.bss)
        *(.bss.*)
        *(COMMON)
        __bss_end = .;
    }

    __end = .;

    /DISCARD/ : {
        *(.comment)
        *(.eh_frame)
        *(.note*)
    }
}
